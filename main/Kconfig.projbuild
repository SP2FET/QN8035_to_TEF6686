## main/Kconfig.projbuild
```kconfig
menu "QN8035 -> TEF6686 bridge"

    config BRIDGE_CPU_DFS
        bool "Scale the idle CPU to 80 MHz (stand-alone only)"
        depends on !BRIDGE_QN_EMU_ENABLE
        select PM_ENABLE
        default y
        help
            Run at the configured default CPU frequency while tasks are active,
            and at 80 MHz while idle. APB stays at 80 MHz; light sleep is disabled
            so native USB stays available. Disabled for QN8035 emulation because
            frequency switching adds interrupt latency to the no-stretch slave.

    menu "TEF6686 tuner (I2C master)"
        config BRIDGE_TEF_I2C_SDA_GPIO
            int "SDA GPIO"
            range 0 46
            default 16

        config BRIDGE_TEF_I2C_SCL_GPIO
            int "SCL GPIO"
            range 0 46
            default 17

        config BRIDGE_TEF_I2C_AUTOSWAP
            bool "Try swapped SDA/SCL if the tuner does not answer"
            default y
            help
                Bring-up aid: if nothing ACKs the tuner address with the
                configured pins, retry with SDA and SCL exchanged and log
                which order worked. Disable once the wiring is known.

        config BRIDGE_TEF_I2C_FREQ_HZ
            int "I2C clock (Hz)"
            range 10000 400000
            default 400000

        choice BRIDGE_TEF_REFCLK
            prompt "Reference clock"
            default BRIDGE_TEF_REFCLK_12M
            help
                Must match the crystal (or clock) on the TEF6686 module.
                Read the marking on the crystal next to the chip. If it is
                shielded: a wrong value still tunes, but stations sit off the
                broadcast grid and neither the stereo pilot nor RDS locks,
                even at a strong level. Try each value on a known station.

            config BRIDGE_TEF_REFCLK_4M
                bool "4.000 MHz crystal"
            config BRIDGE_TEF_REFCLK_9M216
                bool "9.216 MHz crystal"
            config BRIDGE_TEF_REFCLK_12M
                bool "12.000 MHz crystal"
            config BRIDGE_TEF_REFCLK_55M
                bool "55.46667 MHz external clock"
        endchoice

        choice BRIDGE_TEF_PATCH
            prompt "Firmware patch"
            default BRIDGE_TEF_PATCH_AUTO

            config BRIDGE_TEF_PATCH_AUTO
                bool "Auto (load V102, switch to V205 if identified)"
            config BRIDGE_TEF_PATCH_V102
                bool "V102 p2.24"
            config BRIDGE_TEF_PATCH_V205
                bool "V205 p5.12"
        endchoice
    endmenu

    menu "Radio"
        config BRIDGE_FM_MIN_KHZ
            int "FM band start (kHz)"
            range 65000 108000
            default 87500

        config BRIDGE_FM_MAX_KHZ
            int "FM band end (kHz)"
            range 65000 108000
            default 108000

        config BRIDGE_FM_STEP_KHZ
            int "FM step (kHz)"
            range 10 200
            default 100

        config BRIDGE_FM_DEFAULT_KHZ
            int "FM frequency after power-up (kHz)"
            range 65000 108000
            default 87500

        choice BRIDGE_FM_DEEMPHASIS
            prompt "FM de-emphasis"
            default BRIDGE_FM_DEEMPHASIS_50
            config BRIDGE_FM_DEEMPHASIS_50
                bool "50 us (Europe, Asia)"
            config BRIDGE_FM_DEEMPHASIS_75
                bool "75 us (Americas)"
        endchoice

        config BRIDGE_AM_STEP_KHZ
            int "MW step (kHz)"
            range 1 10
            default 9

        config BRIDGE_DEFAULT_VOLUME_DB
            int "Volume after power-up (dB)"
            range -60 24
            default 0

        config BRIDGE_MEMORY
            bool "Remember the last station and settings, keep memory channels"
            depends on !BRIDGE_QN_EMU_ENABLE
            default y
            help
                Stand-alone build only. Band, frequency, volume, mute and bandwidth
                survive a power cycle (saved 2 s after the last change), and 40 memory
                channels are managed from the web UI. Both live in the nvs partition;
                with this enabled the two "after power-up" values above apply only
                until something has been saved.

                Not available with QN8035 emulation: there the head unit owns the
                radio state, and a flash write stops the CPU for tens of milliseconds
                while the head unit may be waiting on a stretched clock.
    endmenu

    menu "QN8035 emulation (I2C slave to the head unit)"
        config BRIDGE_QN_EMU_ENABLE
            bool "Emulate a QN8035 towards the head unit"
            default n
            help
                Leave disabled until the head-unit bus is wired and its
                voltage level is checked. With it disabled the firmware is
                a stand-alone TEF6686 test bench.

        config BRIDGE_QN_I2C_SDA_GPIO
            int "SDA GPIO"
            depends on BRIDGE_QN_EMU_ENABLE
            range 0 46
            default 33

        config BRIDGE_QN_I2C_SCL_GPIO
            int "SCL GPIO"
            depends on BRIDGE_QN_EMU_ENABLE
            range 0 46
            default 35

        config BRIDGE_QN_INT_GPIO
            int "INT output GPIO (-1 = not connected)"
            depends on BRIDGE_QN_EMU_ENABLE
            range -1 46
            default -1

        config BRIDGE_QN_TRACE
            bool "Log every head-unit bus transaction"
            depends on BRIDGE_QN_EMU_ENABLE
            default n
            help
                Sniffer mode for bring-up: each register read/write from the
                head unit appears in the log (serial and web console).
                Leave off for normal use to avoid continuous console and WebSocket output.
    endmenu

    menu "Wi-Fi and web UI"
        config BRIDGE_WIFI_ENABLE
            bool "Start Wi-Fi and web UI" if BRIDGE_QN_EMU_ENABLE
            default y
            help
                Disable in the car build to avoid powering the Wi-Fi radio and
                running the HTTP server and log pump. The head unit still controls
                the tuner. Web controls and OTA are unavailable; use USB to flash.
                Always enabled in the stand-alone build, which needs web controls.

        config BRIDGE_WIFI_AP_SSID
            string "Access point SSID"
            default "TEF-Bridge"

        config BRIDGE_WIFI_AP_PASSWORD
            string "Access point password (8+ characters, empty = open)"
            default "tef6686bridge"

        config BRIDGE_WIFI_AP_CHANNEL
            int "Access point channel"
            range 1 13
            default 6

        config BRIDGE_WIFI_TX_POWER_DBM
            int "Transmit power (dBm)"
            range 2 20
            default 8
            help
                The phone sits next to the head unit, so little power is needed.
                At the 20 dBm maximum the transmit bursts draw about 300 mA and pull
                a weak 3.3 V supply down: on 2026-10-25 the bench board reset on
                every client connect with the brown-out level at 2.84 V.

        config BRIDGE_WIFI_STA_SSID
            string "Also join this network (empty = AP only)"
            default ""

        config BRIDGE_WIFI_STA_PASSWORD
            string "Station password"
            default ""

        config BRIDGE_LOG_RING_SIZE
            int "Web console history (bytes)"
            range 1024 65536
            default 8192

        config BRIDGE_OTA_PASSWORD
            string "Firmware upload password (empty = none)"
            default ""
            help
                Required in the X-OTA-Password header of POST /api/ota;
                scripts/ota_upload.py takes it from the OTA_PASSWORD environment
                variable. Empty lets anyone who can reach the web UI replace the
                firmware (the access point itself is WPA2-protected).
    endmenu

endmenu
```
